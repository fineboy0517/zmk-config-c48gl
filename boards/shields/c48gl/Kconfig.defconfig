## config/west.yml
```yaml
# Experimental DYA Studio advanced integration; stable main branch remains intact.
manifest:
  remotes:
    - name: cormoran
      url-base: https://github.com/cormoran
  projects:
    - name: zmk
      remote: cormoran
      revision: e5c9b6915b56801193e359dd9bad4a167ce0d1b8
      import: app/west.yml
    - name: zmk-feature-runtime-macro
      remote: cormoran
      revision: main
    - name: zmk-feature-runtime-combo
      remote: cormoran
      revision: main
    - name: zmk-feature-input-stream
      remote: cormoran
      revision: main
    - name: zmk-module-ble-management
      remote: cormoran
      revision: main
    - name: zmk-feature-default-layer
      remote: cormoran
      revision: b25cb5b324da2d9bbc84e1877c775f5b2b7c6845
    - name: zmk-feature-os-detection
      remote: cormoran
      revision: main
    - name: zmk-module-settings-rpc
      remote: cormoran
      revision: main
    - name: zmk-feature-custom-settings
      remote: cormoran
      revision: main
    - name: zmk-feature-device-info
      remote: cormoran
      revision: main
    - name: zmk-feature-watchdog
      remote: cormoran
      revision: main
    - name: zmk-module-devtool
      remote: cormoran
      revision: main
    - name: zmk-feature-zephyr-setting-expose
      remote: cormoran
      revision: main
    - name: zmk-feature-kscan-diagnostics
      remote: cormoran
      revision: main
  self:
    path: config
```
