// SPDX-License-Identifier: GPL-2.0-or-later
#include <dt-bindings/gpio/gpio.h>
#include <dt-bindings/zmk/matrix_transform.h>
#include "c48gl-layout.dtsi"

/ {
    chosen {
        zmk,kscan = &kscan0;
        zmk,physical-layout = &c48gl_layout;
    };

    // Same active-low, pull-up scanning as the public QMK matrix.c.
    // Pins 0..3 = R0..R3; pins 4..9 = C0..C5.
    // QMK left (r,c) -> RC(r,4+c), right (4+r,c) -> RC(4+c,r).
    kscan0: kscan {
        compatible = "zmk,kscan-gpio-charlieplex";
        // No interrupt-gpios: the stock PCB has no dedicated IRQ circuit.
        // Polling is required; do not add wakeup-source without hardware support.
        gpios = <&pro_micro 2 GPIO_ACTIVE_LOW>,  // R0: AVR D1
                <&pro_micro 3 GPIO_ACTIVE_LOW>,  // R1: AVR D0
                <&pro_micro 4 GPIO_ACTIVE_LOW>,  // R2: AVR D4
                <&pro_micro 5 GPIO_ACTIVE_LOW>,  // R3: AVR C6
                <&pro_micro 21 GPIO_ACTIVE_LOW>, // C0: AVR F4 / A3
                <&pro_micro 20 GPIO_ACTIVE_LOW>, // C1: AVR F5 / A2
                <&pro_micro 19 GPIO_ACTIVE_LOW>, // C2: AVR F6 / A1
                <&pro_micro 18 GPIO_ACTIVE_LOW>, // C3: AVR F7 / A0
                <&pro_micro 15 GPIO_ACTIVE_LOW>, // C4: AVR B1
                <&pro_micro 14 GPIO_ACTIVE_LOW>; // C5: AVR B3
        debounce-press-ms = <5>;
        debounce-release-ms = <5>;
        debounce-scan-period-ms = <1>;
        poll-period-ms = <5>;
    };
};
